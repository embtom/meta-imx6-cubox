## conf/distro/cuboxdk.conf
```bitbake
require conf/distro/poky.conf

SDK_VERSION = "1.0.0-dev"

DISTRO = "cuboxdk"
DISTRO_NAME = "embtom cuboxdk"
DISTRO_VERSION = "${SDK_VERSION}"
```

## conf/layer.conf
```bitbake
# We have a conf and classes directory, add to BBPATH
BBPATH .= ":${LAYERDIR}"

# We have recipes-* directories, add to BBFILES
BBFILES += "${LAYERDIR}/recipes-*/*/*.bb ${LAYERDIR}/recipes-*/*/*.bbappend ${LAYERDIR}/images/*.bb"

BBFILE_COLLECTIONS += "meta-imx6-cubox"

BBFILE_PATTERN_meta-imx6-cubox = "^${LAYERDIR}/"
BBFILE_PRIORITY_meta-imx6-cubox = "16"

FSL_EULA_FILE = "${LAYERDIR}/EULA"
FSL_MIRROR ?= "http://www.freescale.com/lgfiles/NMG/MAD/YOCTO/"

LAYERSERIES_COMPAT_meta-imx6-cubox = "thud"
```

## conf/machine/imx6-cubox.conf
```bitbake
MACHINEOVERRIDES =. "mx6:mx6dl:mx6q:"

#require conf/machine/include/imx-base.inc
require conf/machine/include/tune-cortexa9.inc
require conf/machine/include/utilities.inc

PREFERRED_PROVIDER_virtual/bootloader = "u-boot-solidrun-imx6"
PREFERRED_PROVIDER_virtual/kernel = "linux-stable"
#PREFERRED_PROVIDER_virtual/kernel = "linux-solidrun-imx6" 

IMAGE_CLASSES += "image_types_fsl"

IMAGE_BOOTLOADER = "u-boot"
SDCARD_ROOTFS ?= "${IMGDEPLOYDIR}/${IMAGE_NAME}.rootfs.ext4"

DISTRO_FEATURES_remove = "x11 wayland vulkan"
DISTRO_FEATURES_append = " opengl"
#DISTRO_FEATURES_append = " x11 opengl"

################################################################
# U-boot settings
################################################################

UBOOT_MACHINE ?= "mx6cuboxi_defconfig"
UBOOT_MAKE_TARGET = "all"
UBOOT_SUFFIX = "img"
SPL_BINARY = "SPL"
WKS_FILE = "imx-uboot-spl.wks"
IMAGE_BOOT_FILES_append = " extlinux.conf;extlinux/extlinux.conf"

UBOOT_EXTLINUX = "1"
UBOOT_EXTLINUX_ROOT = "root=/dev/mmcblk1p2 rootwait video=HDMI-A-1:800x480@60"
#UBOOT_EXTLINUX_ROOT = "root=PARTUUID=${uuid}"

################################################################
# Kernel setings
################################################################

KERNEL_IMAGETYPE = "zImage"
KERNEL_DEVICETREE = " \
    imx6dl-cubox-i.dtb \
    imx6dl-cubox-i-emmc-som-v15.dtb \
    imx6dl-cubox-i-som-v15.dtb \
    imx6q-cubox-i.dtb \
    imx6q-cubox-i-emmc-som-v15.dtb \
    imx6q-cubox-i-som-v15.dtb \
"

SERIAL_CONSOLE = "115200 ttymxc0"

MACHINE_FEATURES += "pci wifi bluetooth alsa irda serial usbhost"
MACHINE_EXTRA_RRECOMMENDS += "firmware-wireless-brcm firmware-wireless-wilink8 "

MACHINE_ESSENTIAL_EXTRA_RDEPENDS += " \
    kernel-image \
    kernel-devicetree \
    u-boot-solidrun-imx6 \
"

IMAGE_BOOT_FILES ?= " \
    ${KERNEL_IMAGETYPE} \
    ${@make_dtb_boot_files(d)} \
    "
IMAGE_FSTYPES += "ext4 tar.gz wic.bmap wic.gz"
 
WKS_FILE = "imx-uboot-spl-bootpart.wks"
```
